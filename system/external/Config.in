## system/external/Config.in
```kconfig
# SPDX-License-Identifier: GPL-2.0-or-later
source "$BR2_EXTERNAL_LAPINLIBRE_PATH/package/protobuf-karotz/Config.in"
source "$BR2_EXTERNAL_LAPINLIBRE_PATH/package/libmpd-karotz/Config.in"
source "$BR2_EXTERNAL_LAPINLIBRE_PATH/package/libosip2-karotz/Config.in"
source "$BR2_EXTERNAL_LAPINLIBRE_PATH/package/libexosip2-karotz/Config.in"
source "$BR2_EXTERNAL_LAPINLIBRE_PATH/package/linphone-karotz/Config.in"
source "$BR2_EXTERNAL_LAPINLIBRE_PATH/package/python24-karotz/Config.in"
source "$BR2_EXTERNAL_LAPINLIBRE_PATH/package/dbus-python-karotz/Config.in"
source "$BR2_EXTERNAL_LAPINLIBRE_PATH/package/simplejson-karotz/Config.in"
source "$BR2_EXTERNAL_LAPINLIBRE_PATH/package/mpd-karotz/Config.in"
source "$BR2_EXTERNAL_LAPINLIBRE_PATH/package/glib-compile-schemas-karotz/Config.in"
```

## system/external/package/dbus-python-karotz/Config.in
```kconfig
# SPDX-License-Identifier: GPL-2.0-or-later
config BR2_PACKAGE_DBUS_PYTHON_KAROTZ
	bool "dbus-python-karotz"
	depends on BR2_PACKAGE_PYTHON24_KAROTZ
	select BR2_PACKAGE_DBUS_GLIB
	help
	  dbus-python 0.83.0, for Python 2.4.

	  https://dbus.freedesktop.org/doc/dbus-python/
```

## system/external/package/glib-compile-schemas-karotz/Config.in
```kconfig
# SPDX-License-Identifier: GPL-2.0-or-later
config BR2_PACKAGE_GLIB_COMPILE_SCHEMAS_KAROTZ
	bool "glib-compile-schemas-karotz"
	depends on BR2_PACKAGE_LIBGLIB2
	help
	  GLib's glib-compile-schemas on the target, which Buildroot's
	  libglib2 package deletes with the other developer tools.
```

## system/external/package/libexosip2-karotz/Config.in
```kconfig
# SPDX-License-Identifier: GPL-2.0-or-later
config BR2_PACKAGE_LIBEXOSIP2_KAROTZ
	bool "libexosip2-karotz"
	depends on BR2_TOOLCHAIN_HAS_THREADS
	select BR2_PACKAGE_LIBOSIP2_KAROTZ
	help
	  libeXosip2 3.5.0 (libeXosip2.so.6), for linphone
	  3.4.1.

	  https://savannah.nongnu.org/projects/exosip
```

## system/external/package/libmpd-karotz/Config.in
```kconfig
# SPDX-License-Identifier: GPL-2.0-or-later
config BR2_PACKAGE_LIBMPD_KAROTZ
	bool "libmpd-karotz"
	depends on BR2_USE_WCHAR # libglib2
	depends on BR2_TOOLCHAIN_HAS_THREADS # libglib2
	depends on BR2_USE_MMU # libglib2
	select BR2_PACKAGE_LIBGLIB2
	help
	  libmpd 0.17.0 with the Karotz changes (the genre list and
	  the external-client count), the libmpd.so.0 that
	  multimedia-daemon uses.

	  https://www.musicpd.org/
```

## system/external/package/libosip2-karotz/Config.in
```kconfig
# SPDX-License-Identifier: GPL-2.0-or-later
config BR2_PACKAGE_LIBOSIP2_KAROTZ
	bool "libosip2-karotz"
	depends on BR2_TOOLCHAIN_HAS_THREADS
	help
	  libosip2 3.5.0 (libosip2.so.6), for linphone 3.4.1.

	  https://www.gnu.org/software/osip/
```

## system/external/package/linphone-karotz/Config.in
```kconfig
# SPDX-License-Identifier: GPL-2.0-or-later
config BR2_PACKAGE_LINPHONE_KAROTZ
	bool "linphone-karotz"
	depends on BR2_TOOLCHAIN_HAS_THREADS
	select BR2_PACKAGE_LIBEXOSIP2_KAROTZ
	select BR2_PACKAGE_SPEEX
	help
	  linphone 3.4.1's libraries (with oRTP and mediastreamer2),
	  for k2k-daemon.

	  https://www.linphone.org/
```

## system/external/package/mpd-karotz/Config.in
```kconfig
# SPDX-License-Identifier: GPL-2.0-or-later
config BR2_PACKAGE_MPD_KAROTZ
	bool "mpd-karotz"
	depends on BR2_USE_WCHAR # libglib2
	depends on BR2_TOOLCHAIN_HAS_THREADS # libglib2
	depends on BR2_USE_MMU # libglib2
	depends on BR2_PACKAGE_FFMPEG_ARCH_SUPPORTS
	select BR2_PACKAGE_LIBGLIB2
	select BR2_PACKAGE_LIBMAD
	select BR2_PACKAGE_LIBID3TAG
	select BR2_PACKAGE_TREMOR
	select BR2_PACKAGE_FFMPEG
	select BR2_PACKAGE_LIBCURL
	select BR2_PACKAGE_LIBMMS
	select BR2_PACKAGE_ZLIB
	help
	  mpd 0.15.12 with the Karotz count_externalClient status field,
	  and its FFmpeg decoder ported to FFmpeg 6.1.
	  multimedia-daemon plays the USB key's music through it.

	  https://www.musicpd.org/
```

## system/external/package/protobuf-karotz/Config.in
```kconfig
# SPDX-License-Identifier: GPL-2.0-or-later
config BR2_PACKAGE_PROTOBUF_KAROTZ
	bool "protobuf-karotz"
	depends on BR2_INSTALL_LIBSTDCPP
	depends on BR2_TOOLCHAIN_HAS_THREADS
	help
	  Google's protocol buffers at 2.3.0 (libprotobuf.so.6), which
	  LapinLibre's controller,
	  voice-daemon and karotzVM use. Buildroot's own protobuf package is a much newer API.

	  https://github.com/protocolbuffers/protobuf
```

## system/external/package/python24-karotz/Config.in
```kconfig
# SPDX-License-Identifier: GPL-2.0-or-later
config BR2_PACKAGE_PYTHON24_KAROTZ
	bool "python24-karotz"
	depends on BR2_USE_WCHAR
	select BR2_PACKAGE_EXPAT
	select BR2_PACKAGE_ZLIB
	help
	  Python 2.4.5 (python2.4), for the rabbit's scripts,
	  with Buildroot 2010.11's python.mk recipe.

	  https://www.python.org/
```

## system/external/package/simplejson-karotz/Config.in
```kconfig
# SPDX-License-Identifier: GPL-2.0-or-later
config BR2_PACKAGE_SIMPLEJSON_KAROTZ
	bool "simplejson-karotz"
	depends on BR2_PACKAGE_PYTHON24_KAROTZ
	help
	  simplejson 2.0.7's modules, in Python 2.4's library.

	  https://pypi.org/project/simplejson/
```
